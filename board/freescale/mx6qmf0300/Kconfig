## board/freescale/mx6qmf0300/Kconfig
```kconfig
if TARGET_MX6QMF0300

config SYS_BOARD
	default "mx6qmf0300"

config SYS_VENDOR
	default "freescale"

config SYS_SOC
	default "mx6"

config SYS_CONFIG_NAME
	default "mx6qmf0300"

config DEFAULT_PANEL
	string
	help
	  This option indicate the name of the default video output panel.

endif
```

## board/sato/fx3lx/Kconfig
```kconfig
if TARGET_FX3LX

config SYS_BOARD
	default "fx3lx"

config SYS_VENDOR
	default "sato"

config SYS_CONFIG_NAME
	default "fx3lx"

endif
```

## configs/mx6qmf0300_xga_defconfig
```kconfig
CONFIG_SYS_EXTRA_OPTIONS="IMX_CONFIG=board/freescale/mx6qmf0300/mx6q.cfg,MX6Q,DDR_MB=2048,ANDROID_SUPPORT,SYS_BOOT_MMC,DEFAULT_PANEL=LGXGA15,DEFAULT_FDT_FILE=\"imx6q-mf0300-xga.dtb\""
CONFIG_ARM=y
CONFIG_TARGET_MX6QMF0300=y
CONFIG_SYS_MALLOC_F=y
CONFIG_SYS_MALLOC_F_LEN=0x400
CONFIG_DM=y
CONFIG_DM_THERMAL=y
```

## configs/mx6qmf0300android_mfg_defconfig
```kconfig
CONFIG_SYS_EXTRA_OPTIONS="IMX_CONFIG=board/freescale/mx6qmf0300/mx6q.cfg,MX6Q,DDR_MB=2048,ANDROID_SUPPORT,SYS_BOOT_MFG,DEFAULT_PANEL=LGWXGA13,DEFAULT_FDT_FILE=\"imx6q-mf0300-wxga.dtb\""
CONFIG_ARM=y
CONFIG_ARCH_MX6=y
CONFIG_TARGET_MX6QMF0300=y
CONFIG_SYS_MALLOC_F=y
CONFIG_SYS_MALLOC_F_LEN=0x400
CONFIG_DM=y
CONFIG_DM_SPI=y
CONFIG_DM_WARN=y
CONFIG_OF_CONTROL=y
CONFIG_IMX_THERMAL=y
CONFIG_FASTBOOT_STORAGE_MMC=y
CONFIG_AES=y
CONFIG_FIT=y
CONFIG_PARTITIONS=y
CONFIG_DOS_PARTITION=y
CONFIG_EFI_PARTITION=y
CONFIG_PARTITION_UUIDS=y
CONFIG_VIDEO_IPUV3=y
CONFIG_LDO_BYPASS_CHECK=y
CONFIG_SYS_BOOT_MFG=y
CONFIG_ENV_IS_IN_MMC=y
CONFIG_OF_LIBFDT=y
CONFIG_VIDEO=y
CONFIG_VIDEO_MX3=y
CONFIG_VIDEO_IPUV3=y
CONFIG_CFB_CONSOLE=y
```
